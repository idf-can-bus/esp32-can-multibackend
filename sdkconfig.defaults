## sdkconfig.defaults
```kconfig
# Default configuration for CAN bus examples
# This file should be version controlled and used as a template for new projects

# Disable unused features
CONFIG_ESP32_WIFI_ENABLED=n
CONFIG_BT_ENABLED=n
CONFIG_ESP32_SPIRAM_SUPPORT=n
CONFIG_ESP_OTA_ENABLED=n
CONFIG_ESP_HTTP_CLIENT_ENABLED=n
CONFIG_ESP_HTTPS_SERVER_ENABLED=n

# Default CAN driver/library selection
#
# *** CAN bus examples  ***
#
CONFIG_CAN_BACKEND_TWAI=y
# CONFIG_CAN_BACKEND_MCP2515_SINGLE is not set
# CONFIG_CAN_BACKEND_MCP2515_MULTI is not set
CONFIG_EXAMPLE_SEND_SINGLE=y
# CONFIG_EXAMPLE_RECV_POLL_SINGLE is not set
# CONFIG_EXAMPLE_RECV_INT_SINGLE is not set
# end of *** CAN bus examples  ***


# Common ESP-IDF settings
CONFIG_ESPTOOLPY_FLASHMODE_QIO=y
CONFIG_ESPTOOLPY_FLASHFREQ_80M=y
CONFIG_ESPTOOLPY_FLASHSIZE_4MB=y
CONFIG_ESPTOOLPY_MONITOR_BAUD_115200B=y

# Enable FreeRTOS stats formatting functions
CONFIG_FREERTOS_USE_TRACE_FACILITY=y
CONFIG_FREERTOS_USE_STATS_FORMATTING_FUNCTIONS=y

# Enable ESP System Event
CONFIG_ESP_SYSTEM_EVENT_QUEUE_SIZE=32
CONFIG_ESP_SYSTEM_EVENT_TASK_STACK_SIZE=2304

# Enable ESP Log
CONFIG_LOG_DEFAULT_LEVEL_INFO=y
CONFIG_LOG_COLORS=y 
```
